## firmware/rv1106/buildroot_defconfig
```kconfig
# Minimal Buildroot defconfig for Veyro (RV1106G3)
BR2_arm=y
BR2_cortex_a7=y
BR2_ARM_FPU_NEON_VFPV4=y
BR2_TOOLCHAIN_EXTERNAL=y
BR2_TOOLCHAIN_EXTERNAL_CUSTOM=y
BR2_TOOLCHAIN_EXTERNAL_PATH="/opt/arm-rockchip830-linux-gnueabihf"
BR2_TOOLCHAIN_EXTERNAL_CUSTOM_PREFIX="arm-rockchip830-linux-gnueabihf"
BR2_TOOLCHAIN_EXTERNAL_GCC_12=y
BR2_TOOLCHAIN_EXTERNAL_HEADERS_5_10=y
BR2_TARGET_GENERIC_HOSTNAME="veyro"
BR2_TARGET_GENERIC_ISSUE="Veyro"
BR2_ROOTFS_DEVICE_CREATION_DYNAMIC_MDEV=y
BR2_TARGET_ROOTFS_EXT2=y
BR2_TARGET_ROOTFS_EXT2_4=y
BR2_TARGET_ROOTFS_EXT2_SIZE="256M"
# LVGL
BR2_PACKAGE_LVGL=y
BR2_PACKAGE_LVGL_DEMO=y
```
